## Documentation/devicetree/bindings/input/qcom,pm8350b-haptics.yaml
```yaml
# SPDX-License-Identifier: (GPL-2.0-only OR BSD-2-Clause)
%YAML 1.2
---
$id: http://devicetree.org/schemas/input/qcom,pm8350b-haptics.yaml#
$schema: http://devicetree.org/meta-schemas/core.yaml#

title: Qualcomm PM8350B Haptics

maintainers:
  - Oleksii Onchul <oleksiionchul@gmail.com>

description:
  The PM8350B PMIC contains a haptics block for driving linear resonant
  actuators and eccentric rotating mass motors.

properties:
  compatible:
    const: qcom,pm8350b-haptics

  reg:
    items:
      - description: Haptics configuration registers
      - description: Haptics pattern registers
      - description: Haptics boost registers

  reg-names:
    items:
      - const: cfg
      - const: ptn
      - const: hboost

  nvmem:
    description:
      Phandle to the SDAM region used to pass commands to the PMIC
      programmable boot sequencer that controls the HBoost supply.
    maxItems: 1

  nvmem-names:
    items:
      - const: hap_cfg_sdam

  qcom,vmax-microvolt:
    description: Maximum motor drive voltage in microvolts.
    minimum: 50000
    maximum: 11000000
    multipleOf: 50000
    default: 5000000

  qcom,lra-period-us:
    description: Open-loop resonant period of the LRA in microseconds.
    minimum: 5
    maximum: 20475
    multipleOf: 5

  qcom,use-erm:
    type: boolean
    description: Drive an eccentric rotating mass motor instead of an LRA.

required:
  - compatible
  - reg
  - reg-names

dependencies:
  nvmem: [nvmem-names]
  nvmem-names: [nvmem]

additionalProperties: false

examples:
  - |
    pmic {
        #address-cells = <1>;
        #size-cells = <0>;

        haptics@f000 {
            compatible = "qcom,pm8350b-haptics";
            reg = <0xf000>, <0xf100>, <0xf200>;
            reg-names = "cfg", "ptn", "hboost";
            qcom,vmax-microvolt = <5000000>;
            qcom,lra-period-us = <5880>;
        };
    };

...
```

## Documentation/devicetree/bindings/leds/awinic,aw210xx.yaml
```yaml
# SPDX-License-Identifier: (GPL-2.0-only OR BSD-2-Clause)
%YAML 1.2
---
$id: http://devicetree.org/schemas/leds/awinic,aw210xx.yaml#
$schema: http://devicetree.org/meta-schemas/core.yaml#

title: Awinic AW21009, AW21012 and AW21018 LED Controllers

maintainers:
  - Oleksii Onchul <oleksiionchul@gmail.com>

description: |
  The AW21009, AW21012 and AW21018 are I2C-connected LED controllers with
  9, 12 and 18 individually controlled constant-current outputs,
  respectively.

properties:
  compatible:
    enum:
      - awinic,aw21009
      - awinic,aw21012
      - awinic,aw21018

  reg:
    maxItems: 1

  "#address-cells":
    const: 1

  "#size-cells":
    const: 0

  enable-gpios:
    maxItems: 1

patternProperties:
  "^led@[0-9a-f]+$":
    type: object
    $ref: common.yaml#
    unevaluatedProperties: false

    properties:
      reg:
        description: LED output channel
        maxItems: 1

      led-max-microamp:
        description: |
          Maximum output current for this channel. The driver programs the
          per-channel scaling register assuming the maximum supported current
          of 40 mA with the minimum recommended 4 kOhm REXT. A larger REXT
          results in a lower output current.
        minimum: 157
        maximum: 40000
        default: 16000

      max-brightness:
        minimum: 1
        maximum: 255

      default-brightness:
        maximum: 255

      default-state:
        enum:
          - on
          - off

    required:
      - reg

allOf:
  - if:
      properties:
        compatible:
          contains:
            const: awinic,aw21009
    then:
      patternProperties:
        "^led@[0-9a-f]+$":
          properties:
            reg:
              items:
                maximum: 8

  - if:
      properties:
        compatible:
          contains:
            const: awinic,aw21012
    then:
      patternProperties:
        "^led@[0-9a-f]+$":
          properties:
            reg:
              items:
                maximum: 11

  - if:
      properties:
        compatible:
          contains:
            const: awinic,aw21018
    then:
      patternProperties:
        "^led@[0-9a-f]+$":
          properties:
            reg:
              items:
                maximum: 17

required:
  - compatible
  - reg
  - "#address-cells"
  - "#size-cells"

additionalProperties: false

examples:
  - |
    #include <dt-bindings/gpio/gpio.h>
    #include <dt-bindings/leds/common.h>

    i2c {
        #address-cells = <1>;
        #size-cells = <0>;

        led-controller@20 {
            compatible = "awinic,aw21018";
            reg = <0x20>;
            #address-cells = <1>;
            #size-cells = <0>;
            enable-gpios = <&gpio 18 GPIO_ACTIVE_HIGH>;

            led@0 {
                reg = <0>;
                color = <LED_COLOR_ID_WHITE>;
                function = LED_FUNCTION_INDICATOR;
                function-enumerator = <0>;
                led-max-microamp = <16000>;
            };

            led@11 {
                reg = <17>;
                color = <LED_COLOR_ID_WHITE>;
                function = LED_FUNCTION_INDICATOR;
                function-enumerator = <17>;
            };
        };
    };

...
```
